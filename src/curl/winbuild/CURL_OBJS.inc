CURL_OBJS = \
	..\builds\libcurl-release-dll-ssl-dll-zlib--ipv6-sspi-obj-curl/main.obj \
	..\builds\libcurl-release-dll-ssl-dll-zlib--ipv6-sspi-obj-curl/urlglob.obj \
	..\builds\libcurl-release-dll-ssl-dll-zlib--ipv6-sspi-obj-curl/writeout.obj \
	..\builds\libcurl-release-dll-ssl-dll-zlib--ipv6-sspi-obj-curl/writeenv.obj \
	..\builds\libcurl-release-dll-ssl-dll-zlib--ipv6-sspi-obj-curl/getpass.obj \
	..\builds\libcurl-release-dll-ssl-dll-zlib--ipv6-sspi-obj-curl/homedir.obj \
	..\builds\libcurl-release-dll-ssl-dll-zlib--ipv6-sspi-obj-curl/curlutil.obj \
	..\builds\libcurl-release-dll-ssl-dll-zlib--ipv6-sspi-obj-curl/os-specific.obj \
	..\builds\libcurl-release-dll-ssl-dll-zlib--ipv6-sspi-obj-curl/xattr.obj \
 
