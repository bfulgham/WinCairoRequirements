LIBCURL_OBJS = \
	..\builds\libcurl-release-dll-ssl-dll-zlib--ipv6-sspi-obj-lib/file.obj \
	..\builds\libcurl-release-dll-ssl-dll-zlib--ipv6-sspi-obj-lib/timeval.obj \
	..\builds\libcurl-release-dll-ssl-dll-zlib--ipv6-sspi-obj-lib/base64.obj \
	..\builds\libcurl-release-dll-ssl-dll-zlib--ipv6-sspi-obj-lib/hostip.obj \
	..\builds\libcurl-release-dll-ssl-dll-zlib--ipv6-sspi-obj-lib/progress.obj \
	..\builds\libcurl-release-dll-ssl-dll-zlib--ipv6-sspi-obj-lib/formdata.obj \
	..\builds\libcurl-release-dll-ssl-dll-zlib--ipv6-sspi-obj-lib/cookie.obj \
	..\builds\libcurl-release-dll-ssl-dll-zlib--ipv6-sspi-obj-lib/http.obj \
	..\builds\libcurl-release-dll-ssl-dll-zlib--ipv6-sspi-obj-lib/sendf.obj \
	..\builds\libcurl-release-dll-ssl-dll-zlib--ipv6-sspi-obj-lib/ftp.obj \
	..\builds\libcurl-release-dll-ssl-dll-zlib--ipv6-sspi-obj-lib/url.obj \
	..\builds\libcurl-release-dll-ssl-dll-zlib--ipv6-sspi-obj-lib/dict.obj \
	..\builds\libcurl-release-dll-ssl-dll-zlib--ipv6-sspi-obj-lib/if2ip.obj \
	..\builds\libcurl-release-dll-ssl-dll-zlib--ipv6-sspi-obj-lib/speedcheck.obj \
	..\builds\libcurl-release-dll-ssl-dll-zlib--ipv6-sspi-obj-lib/ldap.obj \
	..\builds\libcurl-release-dll-ssl-dll-zlib--ipv6-sspi-obj-lib/ssluse.obj \
	..\builds\libcurl-release-dll-ssl-dll-zlib--ipv6-sspi-obj-lib/version.obj \
	..\builds\libcurl-release-dll-ssl-dll-zlib--ipv6-sspi-obj-lib/getenv.obj \
	..\builds\libcurl-release-dll-ssl-dll-zlib--ipv6-sspi-obj-lib/escape.obj \
	..\builds\libcurl-release-dll-ssl-dll-zlib--ipv6-sspi-obj-lib/mprintf.obj \
	..\builds\libcurl-release-dll-ssl-dll-zlib--ipv6-sspi-obj-lib/telnet.obj \
	..\builds\libcurl-release-dll-ssl-dll-zlib--ipv6-sspi-obj-lib/netrc.obj \
	..\builds\libcurl-release-dll-ssl-dll-zlib--ipv6-sspi-obj-lib/getinfo.obj \
	..\builds\libcurl-release-dll-ssl-dll-zlib--ipv6-sspi-obj-lib/transfer.obj \
	..\builds\libcurl-release-dll-ssl-dll-zlib--ipv6-sspi-obj-lib/strequal.obj \
	..\builds\libcurl-release-dll-ssl-dll-zlib--ipv6-sspi-obj-lib/easy.obj \
	..\builds\libcurl-release-dll-ssl-dll-zlib--ipv6-sspi-obj-lib/security.obj \
	..\builds\libcurl-release-dll-ssl-dll-zlib--ipv6-sspi-obj-lib/krb4.obj \
	..\builds\libcurl-release-dll-ssl-dll-zlib--ipv6-sspi-obj-lib/curl_fnmatch.obj \
	..\builds\libcurl-release-dll-ssl-dll-zlib--ipv6-sspi-obj-lib/fileinfo.obj \
	..\builds\libcurl-release-dll-ssl-dll-zlib--ipv6-sspi-obj-lib/ftplistparser.obj \
	..\builds\libcurl-release-dll-ssl-dll-zlib--ipv6-sspi-obj-lib/wildcard.obj \
	..\builds\libcurl-release-dll-ssl-dll-zlib--ipv6-sspi-obj-lib/krb5.obj \
	..\builds\libcurl-release-dll-ssl-dll-zlib--ipv6-sspi-obj-lib/memdebug.obj \
	..\builds\libcurl-release-dll-ssl-dll-zlib--ipv6-sspi-obj-lib/http_chunks.obj \
	..\builds\libcurl-release-dll-ssl-dll-zlib--ipv6-sspi-obj-lib/strtok.obj \
	..\builds\libcurl-release-dll-ssl-dll-zlib--ipv6-sspi-obj-lib/connect.obj \
	..\builds\libcurl-release-dll-ssl-dll-zlib--ipv6-sspi-obj-lib/llist.obj \
	..\builds\libcurl-release-dll-ssl-dll-zlib--ipv6-sspi-obj-lib/hash.obj \
	..\builds\libcurl-release-dll-ssl-dll-zlib--ipv6-sspi-obj-lib/multi.obj \
	..\builds\libcurl-release-dll-ssl-dll-zlib--ipv6-sspi-obj-lib/content_encoding.obj \
	..\builds\libcurl-release-dll-ssl-dll-zlib--ipv6-sspi-obj-lib/share.obj \
	..\builds\libcurl-release-dll-ssl-dll-zlib--ipv6-sspi-obj-lib/http_digest.obj \
	..\builds\libcurl-release-dll-ssl-dll-zlib--ipv6-sspi-obj-lib/md4.obj \
	..\builds\libcurl-release-dll-ssl-dll-zlib--ipv6-sspi-obj-lib/md5.obj \
	..\builds\libcurl-release-dll-ssl-dll-zlib--ipv6-sspi-obj-lib/curl_rand.obj \
	..\builds\libcurl-release-dll-ssl-dll-zlib--ipv6-sspi-obj-lib/http_negotiate.obj \
	..\builds\libcurl-release-dll-ssl-dll-zlib--ipv6-sspi-obj-lib/http_ntlm.obj \
	..\builds\libcurl-release-dll-ssl-dll-zlib--ipv6-sspi-obj-lib/inet_pton.obj \
	..\builds\libcurl-release-dll-ssl-dll-zlib--ipv6-sspi-obj-lib/strtoofft.obj \
	..\builds\libcurl-release-dll-ssl-dll-zlib--ipv6-sspi-obj-lib/strerror.obj \
	..\builds\libcurl-release-dll-ssl-dll-zlib--ipv6-sspi-obj-lib/hostares.obj \
	..\builds\libcurl-release-dll-ssl-dll-zlib--ipv6-sspi-obj-lib/hostasyn.obj \
	..\builds\libcurl-release-dll-ssl-dll-zlib--ipv6-sspi-obj-lib/hostip4.obj \
	..\builds\libcurl-release-dll-ssl-dll-zlib--ipv6-sspi-obj-lib/hostip6.obj \
	..\builds\libcurl-release-dll-ssl-dll-zlib--ipv6-sspi-obj-lib/hostsyn.obj \
	..\builds\libcurl-release-dll-ssl-dll-zlib--ipv6-sspi-obj-lib/hostthre.obj \
	..\builds\libcurl-release-dll-ssl-dll-zlib--ipv6-sspi-obj-lib/inet_ntop.obj \
	..\builds\libcurl-release-dll-ssl-dll-zlib--ipv6-sspi-obj-lib/parsedate.obj \
	..\builds\libcurl-release-dll-ssl-dll-zlib--ipv6-sspi-obj-lib/select.obj \
	..\builds\libcurl-release-dll-ssl-dll-zlib--ipv6-sspi-obj-lib/gtls.obj \
	..\builds\libcurl-release-dll-ssl-dll-zlib--ipv6-sspi-obj-lib/sslgen.obj \
	..\builds\libcurl-release-dll-ssl-dll-zlib--ipv6-sspi-obj-lib/tftp.obj \
	..\builds\libcurl-release-dll-ssl-dll-zlib--ipv6-sspi-obj-lib/splay.obj \
	..\builds\libcurl-release-dll-ssl-dll-zlib--ipv6-sspi-obj-lib/strdup.obj \
	..\builds\libcurl-release-dll-ssl-dll-zlib--ipv6-sspi-obj-lib/socks.obj \
	..\builds\libcurl-release-dll-ssl-dll-zlib--ipv6-sspi-obj-lib/ssh.obj \
	..\builds\libcurl-release-dll-ssl-dll-zlib--ipv6-sspi-obj-lib/nss.obj \
	..\builds\libcurl-release-dll-ssl-dll-zlib--ipv6-sspi-obj-lib/qssl.obj \
	..\builds\libcurl-release-dll-ssl-dll-zlib--ipv6-sspi-obj-lib/rawstr.obj \
	..\builds\libcurl-release-dll-ssl-dll-zlib--ipv6-sspi-obj-lib/curl_addrinfo.obj \
	..\builds\libcurl-release-dll-ssl-dll-zlib--ipv6-sspi-obj-lib/socks_gssapi.obj \
	..\builds\libcurl-release-dll-ssl-dll-zlib--ipv6-sspi-obj-lib/socks_sspi.obj \
	..\builds\libcurl-release-dll-ssl-dll-zlib--ipv6-sspi-obj-lib/curl_sspi.obj \
	..\builds\libcurl-release-dll-ssl-dll-zlib--ipv6-sspi-obj-lib/slist.obj \
	..\builds\libcurl-release-dll-ssl-dll-zlib--ipv6-sspi-obj-lib/nonblock.obj \
	..\builds\libcurl-release-dll-ssl-dll-zlib--ipv6-sspi-obj-lib/curl_memrchr.obj \
	..\builds\libcurl-release-dll-ssl-dll-zlib--ipv6-sspi-obj-lib/imap.obj \
	..\builds\libcurl-release-dll-ssl-dll-zlib--ipv6-sspi-obj-lib/pop3.obj \
	..\builds\libcurl-release-dll-ssl-dll-zlib--ipv6-sspi-obj-lib/smtp.obj \
	..\builds\libcurl-release-dll-ssl-dll-zlib--ipv6-sspi-obj-lib/pingpong.obj \
	..\builds\libcurl-release-dll-ssl-dll-zlib--ipv6-sspi-obj-lib/rtsp.obj \
	..\builds\libcurl-release-dll-ssl-dll-zlib--ipv6-sspi-obj-lib/curl_threads.obj \
	..\builds\libcurl-release-dll-ssl-dll-zlib--ipv6-sspi-obj-lib/warnless.obj \
	..\builds\libcurl-release-dll-ssl-dll-zlib--ipv6-sspi-obj-lib/hmac.obj \
	..\builds\libcurl-release-dll-ssl-dll-zlib--ipv6-sspi-obj-lib/polarssl.obj \
	..\builds\libcurl-release-dll-ssl-dll-zlib--ipv6-sspi-obj-lib/curl_rtmp.obj \
	..\builds\libcurl-release-dll-ssl-dll-zlib--ipv6-sspi-obj-lib/openldap.obj \
	..\builds\libcurl-release-dll-ssl-dll-zlib--ipv6-sspi-obj-lib/curl_gethostname.obj \
	..\builds\libcurl-release-dll-ssl-dll-zlib--ipv6-sspi-obj-lib/gopher.obj \
	..\builds\libcurl-release-dll-ssl-dll-zlib--ipv6-sspi-obj-lib/axtls.obj \
	..\builds\libcurl-release-dll-ssl-dll-zlib--ipv6-sspi-obj-lib/idn_win32.obj \
	..\builds\libcurl-release-dll-ssl-dll-zlib--ipv6-sspi-obj-lib/http_negotiate_sspi.obj \
	..\builds\libcurl-release-dll-ssl-dll-zlib--ipv6-sspi-obj-lib/cyassl.obj \
	..\builds\libcurl-release-dll-ssl-dll-zlib--ipv6-sspi-obj-lib/http_proxy.obj \
	..\builds\libcurl-release-dll-ssl-dll-zlib--ipv6-sspi-obj-lib/non-ascii.obj \
 
